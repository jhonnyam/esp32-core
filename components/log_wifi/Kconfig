## components/log_wifi/Kconfig
```kconfig
menu "Counter"
    menuconfig LOG_WIFI_TEST_ENABLE
        bool "Enable unit test"
        default y
    if LOG_WIFI_TEST_ENABLE
        
    endif
endmenu
```
